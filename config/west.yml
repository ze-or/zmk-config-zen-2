## config/west.yml
```yaml
manifest:
  remotes:
    - name: ze-or
      url-base: https://github.com/ze-or
  projects:
    - name: zmk
      remote: ze-or
      revision: caksoylar/zen-v2+experimental+mouse
      import: app/west.yml
  self:
    path: config
```
